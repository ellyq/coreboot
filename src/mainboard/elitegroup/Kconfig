## src/mainboard/elitegroup/Kconfig
```kconfig
## SPDX-License-Identifier: GPL-2.0-only

if VENDOR_ELITEGROUP

choice
	prompt "Mainboard model"

source "src/mainboard/elitegroup/*/Kconfig.name"

endchoice

source "src/mainboard/elitegroup/*/Kconfig"

config MAINBOARD_VENDOR
	default "Elitegroup (ECS)"

endif # VENDOR_ELITEGROUP
```

## src/mainboard/elitegroup/b560h6-em/Kconfig
```kconfig
## SPDX-License-Identifier: GPL-2.0-only

if BOARD_ELITEGROUP_B560H6_EM

config BOARD_SPECIFIC_OPTIONS
	def_bool y
	select BOARD_ROMSIZE_KB_24576
	select SOC_INTEL_TIGERLAKE
	select SOC_INTEL_TIGERLAKE_PCH_H
	select SOC_INTEL_COMMON_BLOCK_HDA_VERB
	select SOC_INTEL_COMMON_BLOCK_MEMINIT
	select HAVE_INTEL_PTT
	select HAVE_ACPI_TABLES
	select HAVE_ACPI_RESUME
	select SUPERIO_ITE_IT8629E
	select HAVE_CMOS_DEFAULT
	select HAVE_OPTION_TABLE
	select CRB_TPM

config MAINBOARD_SMBIOS_PRODUCT_NAME
	default "B560H6-EM"

config MAINBOARD_DIR
	default "elitegroup/b560h6-em"

config MAINBOARD_PART_NUMBER
	default "b560h6-em"

config CBFS_SIZE
	default 0xA00000

config POST_DEVICE
	default n

endif
```

## src/mainboard/elitegroup/b560h6-em/Kconfig.name
```kconfig
## SPDX-License-Identifier: GPL-2.0-only

config BOARD_ELITEGROUP_B560H6_EM
	bool "b560h6-em"
```

## src/mainboard/erying/tgl/Kconfig
```kconfig
## SPDX-License-Identifier: GPL-2.0-only

if BOARD_ERYING_TGL

config BOARD_SPECIFIC_OPTIONS
	def_bool y
	select BOARD_ROMSIZE_KB_16384
	select SOC_INTEL_TIGERLAKE
	select SOC_INTEL_TIGERLAKE_PCH_H
	select SOC_INTEL_COMMON_BLOCK_HDA_VERB
	select SOC_INTEL_COMMON_BLOCK_MEMINIT
	select INTEL_GMA_HAVE_VBT
	select HAVE_ACPI_TABLES
	select HAVE_ACPI_RESUME
	select SUPERIO_ITE_IT8613E
	select DRIVERS_UART_8250IO
	select HAVE_CMOS_DEFAULT
	select HAVE_OPTION_TABLE
	select CRB_TPM
	select HAVE_INTEL_PTT

config MAINBOARD_SMBIOS_PRODUCT_NAME
	default "POLESTAR G613 Pro"

config MAINBOARD_DIR
	default "erying/tgl"

config MAINBOARD_PART_NUMBER
	default "erying-tgl"

config CBFS_SIZE
	default 0xA00000

config POST_DEVICE
	default n

endif
```

## src/mainboard/erying/tgl/Kconfig.name
```kconfig
## SPDX-License-Identifier: GPL-2.0-only

config BOARD_ERYING_TGL
	bool "erying-tgl"
```
